// MTx.c


//--------------------------------------
// Copyright    Editor     Time
// Rayto        LiLiang    2016_07_25
//--------------------------------------   


#ifndef   __MTX_C__
#define   __MTX_C__

#include "main.h"
#include "MTx.h"


//-----------------------------------------------------------------------------------------
// 1.global variables

// 1) Static variable，store in flash, to reduce the memory size, the table only records 
//    the corresponding frequence which ignore the frequency divider.
// 2) Attention: if the frequence of the timer is higher, the reloaded value is discreter.
uint16_t const m_acTimerLoad[8000] =     // frep:(50 ~ 3150) * 8     
#if 0  // for overflow value
//  reserved 
#else  // for comparing value
{   // --- 9MHz * 1, Start Creating Array, divice : 16 ---  
	0xFFFF, 0xFFFF, 0xFFFF, 0xFFFF, 0xFFFF, 0xFFFF, 0xFFFF, 0xFFFF, 0xFFFF, 0xFFFF, 
	0xE666, 0xD174, 0xC000, 0xB13B, 0xA492, 0x9999, 0x9000, 0x8787, 0x8000, 0x7943, 
	0x7333, 0x6DB6, 0x68BA, 0x642C, 0x6000, 0x5C28, 0x589D, 0x5555, 0x5249, 0x4F72, 
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	0x0049, 0x0049, 0x0049, 0x0049, 0x0049, 0x0049, 0x0049, 0x0049, 0x0049, 0x0049
};

#endif


/*****************************************************************************************/
/*****************************************************************************************/
//  The code following (between two clear signs) should be set carefully by the user!!!

#define      MTx_NUM           3 //MOTOR_NUMBER  // 3 


//enum eOutType CODE_ MTx_EN[MTx_NUM]  = 
//{
//	O_MT_01_EN,
//	O_MT_02_EN,
//	O_MT_03_EN
//};
//enum eOutType CODE_ MTx_CLK[MTx_NUM] = 
//{
//	O_MT_01_CLK,
//	O_MT_02_CLK,
//	O_MT_03_CLK
//};
//enum eOutType CODE_ MTx_DIR[MTx_NUM] = 
//{
// 	O_MT_01_DIR,
//	O_MT_02_DIR,
//	O_MT_03_DIR
//};
//enum eOutType CODE_ MTx_PWR[MTx_NUM] = 
//{
// 	O_MT_01_PWR,
//	O_MT_02_PWR,
//	O_MT_03_PWR
//};
//enum eInType  CODE_ MTx_Home[MTx_NUM] = 
//{
// 	I_CH_01,
//	I_CH_03,
//	I_CH_02
//};
//TIM_TypeDef*  CODE_ MTx_Timer[MTx_NUM] = 
//{
// 	TIM2,
//	TIM3,
//	TIM4
//};
uint32_t CODE_ MTx_FreqMin[MTx_NUM] =
{
	0,
	0,
	0
};
uint32_t CODE_ MTx_FreqMax[MTx_NUM] =  // 32 * 8000
{
	256000,
	256000,
	256000
};
uint32_t CODE_ MTx_FreqInc[MTx_NUM] =
{
	4000,
	4000,
	4000
};
uint32_t CODE_ MTx_Distance[MTx_NUM] =
{
	1000000,
	1000000,
	1000000
};
//enum eFlag CODE_ MTx_eCircle[MTx_NUM] =
//{
//    e_False,
//	e_False,
//	e_False
//};

///*
//HW_MOT_ID_BOARD           1
//HW_MOT_ID_SAMPLE          2
//HW_MOT_ID_FOCUS           0
//*/
//enum eMotorPinLevel	 CODE_ MTx_eLevelPosDirection[MTx_NUM] =
//{
//    // 2016-10-11
//    Motor_Pin_Low,    // focus 
//	Motor_Pin_High,	   // board 
//	Motor_Pin_Low      // sample 
//};


//-----------------------------------------------------------------------------------------
// 1.macro definition

// 1) the clock's frequence of the timer
// #define MOTOR_CLOCK_TICKS       TIMER2_TICKS  // 22118400 ticks / 1s 

// 2) frequency divider, "shift left" replaces "division operation"
#define MTx_FREQ_OFFSET_BITS(ch)   4 // 2 ^ 4 = 16            

// 3) output the messages or not, can display the curve of the motor's frequence
#define MTx_WAVE_OUTPUT(ch)        0

//// 4) rectilinear movement or circular movement
//#define MTx_LINE_MOV(ch)      (e_False == MTx_eCircle[ch])  // attention: parentheses()
//#define MTx_CIRCLE_MOV(ch)    (e_True  == MTx_eCircle[ch])  // attention: parentheses()


////---------------------------------------------------------------
//// 2.pin control
//// 1) pin initialization
//#define  MTx_IN_OUT_PIN_INIT(ch)          { PF_OutputInit(MTx_CLK[ch]); \
//                                            PF_OutputInit(MTx_EN[ch]);  \
//                                            PF_OutputInit(MTx_DIR[ch]); \
//                                            PF_OutputInit(MTx_PWR[ch]); \
//                                            PF_InputInit(MTx_Home[ch], IN_MODEL_GPIO);\
//										   }
//// 2) output
////
//#if 1
//// low level
//#define  MTx_OUT_DRIVER_LOCK(ch)           {if(2 == ch)\
//	                                        PF_OutputSet(MTx_EN[ch]);\
//	                                        else\
//                                            PF_OutputClr(MTx_EN[ch]);\
//											PF_OutputClr(MTx_PWR[ch]);\
//										   }/* 注意最后一条语句if和else的条件都会执行 CKP _ADD_20171208 */
//										    /* 标本仓非螺杆驱动需要消耗电流锁定 CKP _ADD_20171208 */
//// high level
//#define  MTx_OUT_DRIVER_UNLOCK(ch)         {PF_OutputSet(MTx_EN[ch]);\
//											PF_OutputSet(MTx_PWR[ch]);\
//                                           } 
//#else 
//// low level
//#define  MTx_OUT_DRIVER_LOCK(ch)           {PF_OutputSet(MTx_EN[ch]);\
//											PF_OutputClr(MTx_PWR[ch]);\
//										   }
//// high level
//#define  MTx_OUT_DRIVER_UNLOCK(ch)         {PF_OutputSet(MTx_EN[ch]);\
//											PF_OutputSet(MTx_PWR[ch]);\
//                                           }

//#endif
////
//#define  MTx_OUT_DIR_POSITIVE(ch)          {\
//                                            if(Motor_Pin_High == MTx_eLevelPosDirection[ch])\
//                                            	PF_OutputSet(MTx_DIR[ch]);\
//                                            else\
//												PF_OutputClr(MTx_DIR[ch]);\
//										   }
//#define  MTx_OUT_DIR_NEGATIVE(ch)          {\
//                                            if(Motor_Pin_Low == MTx_eLevelPosDirection[ch])\
//                                            	PF_OutputSet(MTx_DIR[ch]);\
//                                            else\
//												PF_OutputClr(MTx_DIR[ch]);\
//										   }

//#define  MTx_OUT_PULSE_HIGH(ch)            {PF_OutputSet(MTx_CLK[ch]);} // \
//	                                        //printf("1");} 
//#define  MTx_OUT_PULSE_LOW(ch)             {PF_OutputClr(MTx_CLK[ch]);} // \
//	                                        //printf("0");}
//// 3) input
//#define  MTx_IN_LIMIT_GET(ch)              PF_InputGetState(MTx_Home[ch])  // attention: has return-value  !!!

//---------------------------------------------------------------
// 3.timer control
// 1) timer init
#define MTx_TIMER_INIT(ch)                 {PF_InitMotorTimer(ch);}
// 2) enable the interrupt 
#define MTx_TIMER_INTERRUPT_ON(ch)         {TIM_ITConfig(TIM3, TIM_IT_Update, ENABLE);}
// 3) disable the interrupt
#define MTx_TIMER_INTERRUPT_OFF(ch)        {TIM_ITConfig(TIM3, TIM_IT_Update, DISABLE);}
// 4) clean the flag of interrupt
#define MTx_TIMER_INTERRUPT_FLAG_CLEAR(ch) {TIM_ClearITPendingBit(TIM3 , TIM_FLAG_Update);}
// 5) counting is on 
#define MTx_TIMER_COUNT_ON(ch)             {TIM_Cmd(TIM3, ENABLE);} 
// 6) counting is off
#define MTx_TIMER_COUNT_OFF(ch)            {TIM_Cmd(TIM3, DISABLE);}
// 7) change the reloaded value and don't effect the counter's value
#define MTx_TIMER_LOAD(ch, VALUE)          {TIM_SetAutoreload(TIM3, (VALUE));} // {TIM_SetCounter(MTx_Timer[ch], (VALUE));}  
// 8) the index of the timer's interrupt
// #define MTx_TIMER_INTERRUPT_INDEX       // the interrupt's index

//---------------------------------------------------------------
// 4.global parameters which protect the driver and machinery
// attention: the value following should be set carefully
// 1) the minimum of the motor's frequence
#define MTx_VALUE_FREQ_MIN(ch)             MTx_FreqMin[ch]            
// 2) the maximum of the motor's frequence
#define MTx_VALUE_FREQ_MAX(ch)             MTx_FreqMax[ch]  // 32 * 8000
// 3) the maximum increment of the motor's frequence
#define MTx_VALUE_FREQ_INC(ch)             MTx_FreqInc[ch]
// 4) the maximum  steps of the total run(rectilinear movement or circular movement)
#define MTx_VALUE_DISTANCE_MAX(ch)         MTx_Distance[ch] 


//---------------------------------------------------------------
// 5. for time delay, check whether use the OS, 2ms
#define MTx_DelayMs(n)        {OSTimeDly(n);}    // {IT_SYS_DlyMs(n);}   
//#define MTx_DelayMs(n)        {IT_SYS_DlyMs(n);}  


/*****************************************************************************************/
/*****************************************************************************************/


//-----------------------------------------------------------------------------------------
// static variables in this module

// control the motor
__IO struct tMotorControl  m_atMotorControl[MTx_NUM];
//// record the motor's status
//_STA_ __IO struct tMotorStatus  XRAM_ m_atMotorStatus[MTx_NUM];		
//// monitor the io's level every pulse
//// 1) home-OC input
//_STA_ __IO struct tMonitorIo    XRAM_ m_atMonitorIoLimit[MTx_NUM];
// 2) other inputs

static uint8_t m_io_level_changed[MTx_NUM];  /* 光耦翻转标志  0x00未发生光耦翻转  0xff表示已经发生翻转 */

//-----------------------------------------------------------------------------------------
// function definition

// 
uint8_t  MTx_InitMotor(uint8_t chIndex)
{
    // check
//    if(chIndex >= MTx_NUM)
//    {
//		return e_Feedback_Error;
//	}
	// timer init, but don't start counting
//	MTx_IN_OUT_PIN_INIT(chIndex);
//	MTx_TIMER_INIT(chIndex);
//	MTx_DriverEnable(chIndex, e_False);    // stop the driver at the begining

    // status
	m_atMotorStatus[chIndex].nStepsCur     = 0;
	// control
	m_atMotorControl[chIndex].nCurFreq     = 0;
	m_atMotorControl[chIndex].nTimeLoad    = 0;
	m_atMotorControl[chIndex].nFreqMin     = MTx_VALUE_FREQ_MIN(chIndex);
	m_atMotorControl[chIndex].nFreqMax     = MTx_VALUE_FREQ_MAX(chIndex);
	m_atMotorControl[chIndex].nFreqInc     = MTx_VALUE_FREQ_INC(chIndex);
	m_atMotorControl[chIndex].nFreqSam     = 1;   //
	m_atMotorControl[chIndex].nStepsAcc    = 0;
	m_atMotorControl[chIndex].nStepsEqu    = 0;
	m_atMotorControl[chIndex].nStepsDec    = 0;
	m_atMotorControl[chIndex].nStepsTotal  = 0;
	m_atMotorControl[chIndex].eDirection   = Motor_Direction_Positive;
	m_atMotorControl[chIndex].ePhase       = Motor_Phase_IDLE;

	// monitor the special IO's change every pulse
	MTx_IoInit(chIndex);
	
    return e_Feedback_Success;
}

//
uint8_t  MTx_DriverEnable(uint8_t chIndex, enum eFlag bAble)
{
    // check
    if(chIndex >= MTx_NUM)
    {
		return e_Feedback_Error;
	}
	//
    if(e_False == bAble)
    {
        MTx_OUT_DRIVER_LOCK(chIndex);
		MTx_TIMER_COUNT_OFF(chIndex);
	}
	else
	{
        MTx_OUT_DRIVER_UNLOCK(chIndex);  // free
        MTx_TIMER_COUNT_ON(chIndex);
	}
	MTx_OUT_PULSE_LOW(chIndex);
		
    return e_Feedback_Success;
}

// 
uint8_t  MTx_Move(uint8_t  chIndex, 
				uint32_t nFreqMin, 
				uint32_t nFreqMax, 
				uint32_t nFreqInc, 
				uint32_t nFreqSam, 
				uint32_t nSteps, 
				enum eMotorDirection eDir)
{
    __IO uint32_t XRAM_  nValue = 0;
	__IO uint32_t XRAM_  nBase  = 0;
	__IO uint32_t XRAM_  nAllow = 0;
	__IO uint32_t XRAM_  nAcc   = 0;
	__IO uint32_t XRAM_  nEqu   = 0;

    // check
    if(chIndex >= MTx_NUM)
    {
		return e_Feedback_Error;
	}
	
    //-----------------------------------
    // 1. checking the range of distance 
#if 0    
    if(MTx_LINE_MOV(chIndex)) 
	{
	    // 1) rectilinear movement
	    if(Motor_Direction_Negative == eDir)
	    {
	        if(nSteps > m_atMotorStatus[chIndex].nStepsCur)
	        {
	            return e_Feedback_Error;
			}
		}
		else
		{
	        if( (nSteps + m_atMotorStatus[chIndex].nStepsCur) > MTx_VALUE_DISTANCE_MAX(chIndex))
	        {
	            return e_Feedback_Error;
			}
		}
	}

    //
    if(MTx_CIRCLE_MOV(chIndex))
    {
    	// 2) circular movement
    
    	// ignore distance protect
    }
#endif

    //-----------------------------------
    // 2. checking the parameters 
    // 1) error parameters of global
    if( (0 == MTx_VALUE_FREQ_INC(chIndex)) ||      
		(MTx_VALUE_FREQ_MIN(chIndex) > MTx_VALUE_FREQ_MAX(chIndex)) ||
		(MTx_VALUE_FREQ_INC(chIndex) > MTx_VALUE_FREQ_MAX(chIndex)) )
    {
        return e_Feedback_Error;  // the protected parameters set by user above are wrong
	}
    // 2) error parameters of movement
    if( // (0 == nFreqInc) ||     // attention: can be equal to "0"
		(0 == nFreqSam) ||
		(0 == nFreqInc) ||
		(nFreqMin > nFreqMax) ||
		(nFreqInc > nFreqMax) ||
		(nFreqMin > MTx_VALUE_FREQ_MAX(chIndex)) ||
		(nFreqMax < MTx_VALUE_FREQ_MIN(chIndex)) )
    {
        return e_Feedback_Error;
	}

    //***********************************
    MOT_OS_LOCK();
	//
	//-----------------------------------
    // 3. correct the parameters of the movement
    // 1) min
	if(nFreqMin < MTx_VALUE_FREQ_MIN(chIndex))
	{
        m_atMotorControl[chIndex].nFreqMin = MTx_VALUE_FREQ_MIN(chIndex);
	}
	else
	{
        m_atMotorControl[chIndex].nFreqMin = nFreqMin;
	}
	// 2) max
	if(nFreqMax > MTx_VALUE_FREQ_MAX(chIndex))
	{
        m_atMotorControl[chIndex].nFreqMax = MTx_VALUE_FREQ_MAX(chIndex);
	}
	else
	{
        m_atMotorControl[chIndex].nFreqMax = nFreqMax;
	}
	// 3) inc
	if(nFreqInc > MTx_VALUE_FREQ_INC(chIndex))
	{
        m_atMotorControl[chIndex].nFreqInc = MTx_VALUE_FREQ_INC(chIndex);
	}
	else
	{
        m_atMotorControl[chIndex].nFreqInc = nFreqInc;
	}
	// 4) sam
	m_atMotorControl[chIndex].nFreqSam = nFreqSam;

    //-----------------------------------
    // 4. calculate the curve of the movement according to the parameters 
    // 1) stairs needed of two ways
    nBase  = (uint32_t)( (m_atMotorControl[chIndex].nFreqMax - m_atMotorControl[chIndex].nFreqMin) / m_atMotorControl[chIndex].nFreqInc);     
	nAllow = (uint32_t)( (nSteps / 2) / m_atMotorControl[chIndex].nFreqSam );
	// 2) select the minimum
	if(nBase >= nAllow)
	{
        nAcc = nAllow;
	}
	else
	{
        nAcc = nBase;
	}
	// 3) the steps of phase speed-up or phase speed-reduce
	nValue = (uint32_t)( nAcc * m_atMotorControl[chIndex].nFreqSam );
   	nAcc   = nValue;
	// 4) the steps of phase speed-keep
   	nValue = (uint32_t)( nAcc * 2 );
	if(nValue > nSteps)
	{
	    nAcc = 0;
        nEqu = nSteps;
	}
	else
	{
	    // keep value "nACC"
        nEqu = nSteps - nValue;
	}
	// 5) attention: disable the interrupt of the timer 
	MTx_DriverEnable(chIndex, e_False);
	// 6) generating the parametes for a new movement
	m_atMotorControl[chIndex].nStepsAcc   = nAcc;
	m_atMotorControl[chIndex].nStepsDec   = nAcc;
	m_atMotorControl[chIndex].nStepsEqu   = nEqu;
	m_atMotorControl[chIndex].nStepsTotal = nSteps;
    // 
	m_atMotorControl[chIndex].eDirection  = eDir;
	m_atMotorControl[chIndex].ePhase      = Motor_Phase_IDLE;
	//
	m_atMotorControl[chIndex].nCurFreq  = m_atMotorControl[chIndex].nFreqMin;
	nValue = m_atMotorControl[chIndex].nCurFreq >> MTx_FREQ_OFFSET_BITS(chIndex);
	m_atMotorControl[chIndex].nTimeLoad = m_acTimerLoad[nValue];
    // 7) enable the timer 
	MTx_DriverEnable(chIndex, e_True);

    //***********************************
    MOT_OS_UNLOCK();
	//
	//-----------------------------------
	// 5. test output
#if 0 // MTx_WAVE_OUTPUT(chIndex)	
    printf("\r\n --- motor %d --- \r\n", chIndex);
	printf( "\r\n-nAcc:%u \r\n-nDec:%u \r\n-nEqu:%u \r\n-nTotal:%u \r\n-Dir:%u \r\n",
	       (int)nAcc, (int)nAcc, (int)nEqu, (int)nSteps, (int)eDir); 
#endif

	return e_Feedback_Success;
}

//
uint8_t  MTx_Stop(uint8_t chIndex, uint32_t nSteps, enum eFlag bSlowStop)
{
    // check
    if(chIndex >= MTx_NUM)
    {
		return e_Feedback_Error;
	}
	//
    if( (e_False == bSlowStop) ||
    	(Motor_Phase_IDLE == m_atMotorControl[chIndex].ePhase) ) // protection, don't call "XX_Wait"
    {
		m_atMotorControl[chIndex].nStepsAcc   = 0;
		m_atMotorControl[chIndex].nStepsEqu   = 0;
		m_atMotorControl[chIndex].nStepsDec   = 0;
        m_atMotorControl[chIndex].nStepsTotal = 0;
    }
	else // stop smoothly
	{   
	    MTx_TIMER_INTERRUPT_OFF(chIndex);  // close the interrupt, or the PWM will go wrong
        if( (nSteps >= m_atMotorControl[chIndex].nStepsDec) &&      // greater
			(Motor_Phase_EQU == m_atMotorControl[chIndex].ePhase) ) // phase "EQU"
        {
            m_atMotorControl[chIndex].nStepsAcc   = 0;
            m_atMotorControl[chIndex].nStepsEqu   = nSteps - m_atMotorControl[chIndex].nStepsDec;
			// keep the value of "m_atMotorControl[chIndex].nStepsDec"
			m_atMotorControl[chIndex].nStepsTotal = nSteps;
		}
		else // ignore "nSteps", slow down by itself
		{   
		    m_atMotorControl[chIndex].nStepsAcc   = 0;
			m_atMotorControl[chIndex].nStepsEqu   = 0;
			// keep the value of "m_atMotorControl[chIndex].nStepsDec"
            m_atMotorControl[chIndex].nStepsTotal = nSteps;  // m_atMotorControl[chIndex].nStepsDec;
		}
		MTx_TIMER_INTERRUPT_ON(chIndex);
	}

    // wait until the movement is finished
    MTx_Wait(chIndex, 0, e_False);

	return e_Feedback_Success;
}

/* 返回光耦翻转标志  0x00未发生光耦翻转  0xff表示已经发生翻转 */
uint8_t mtx_get_io_level_changed(uint8_t chIndex)
{
    if(chIndex >= MTx_NUM)
    {
		return e_Feedback_Error;
	}

    return m_io_level_changed[chIndex];
}

/* 参数chIndex为通道号 */
/* 参数nDlyMs为等待的最大超时时间，但bDlyType为TRUE时有效 */
/* 参数bDlyType为是否启用超时判断 */
uint8_t  MTx_Wait(uint8_t chIndex, uint32_t nDlyMs, enum eFlag bDlyType)
{
    __IO uint8_t  XRAM_ chReturn = e_Feedback_Success;
	__IO uint32_t XRAM_ nCount   = 0;

    // check
    if(chIndex >= MTx_NUM)
    {
		return e_Feedback_Error;
	}
	//
	if(e_False == bDlyType)
	{
	    while(m_atMotorControl[chIndex].nStepsTotal > 0)
	    {
			// 
	        MTx_DelayMs(1);      // 2ms  
		}
	}
	else
	{
	    nCount = 0;
	    while(m_atMotorControl[chIndex].nStepsTotal > 0)
	    {
	        // 
	        MTx_DelayMs(1);      // 2ms    
			//	
		    nCount += 1;         // attention: + 2
		    if(nCount >= nDlyMs) // overtime
		    {
			    chReturn = e_Feedback_Fail;  
				//
			    break; 
		    } 
		  
	    }
	   
	} //
	
    MTx_DriverEnable(chIndex, e_False);
	
	return chReturn;
}

//
uint32_t MTx_GetStepsLeft(uint8_t chIndex)
{
    // check
    if(chIndex >= MTx_NUM)
    {
		return 0;  // error
	}
	//
    return m_atMotorControl[chIndex].nStepsTotal;
}

//
uint32_t MTx_GetPosCur(uint8_t chIndex)
{
    // check
    if(chIndex >= MTx_NUM)
    {
		return 0;  // error
	}
	//
    return m_atMotorStatus[chIndex].nStepsCur;
}

//
uint8_t  MTx_SetPosCur(uint8_t chIndex, uint32_t nSteps)
{
    // check
    if(chIndex >= MTx_NUM)
    {
		return e_Feedback_Error;
	}
	//
    if(nSteps > MTx_VALUE_DISTANCE_MAX(chIndex))
    {
        return e_Feedback_Fail;
	}
	
    m_atMotorStatus[chIndex].nStepsCur = nSteps;

	return e_Feedback_Success;
}

//-----------------------------------------------------------------------------------------
// configure the IO's detection
uint8_t  MTx_IoInit(uint8_t chIndex)
{
    // check
    if(chIndex >= MTx_NUM)
    {
		return e_Feedback_Error;
	}
	
    // 1) disable when initialize
    m_atMonitorIoLimit[chIndex].bAble = e_False;

	// 2) for other's IO input
	
	return e_Feedback_Success;
}

uint8_t  MTx_IoConfig(uint8_t chIndex, enum eFlag bAble, uint32_t nStepsSlow)
{
    // check
    if(chIndex >= MTx_NUM)
    {
		return e_Feedback_Error;
	}
	
    // 1) for home-OC input
    // functional seting
    m_atMonitorIoLimit[chIndex].bAble = bAble;
	// status recorded
	m_atMonitorIoLimit[chIndex].nStepsSlow = nStepsSlow;
	m_atMonitorIoLimit[chIndex].chLevelLst = MTx_IN_LIMIT_GET(chIndex);

    // 2) for other's IO input
    m_io_level_changed[chIndex] = 0x00;  /* 准备运行前清除标志位 */
    
    return e_Feedback_Success;
}

void   MTx_IoMinitor(uint8_t chIndex)
{
    uint8_t  XRAM_ chCurLevel;

    // check
    if(chIndex >= MTx_NUM)
    {
		return;  // error
	}
	
	// 1. for home-OC input
    if(e_False != m_atMonitorIoLimit[chIndex].bAble)
	{
	    //-----------------------------------------
	    // 1) get the current level
        chCurLevel = MTx_IN_LIMIT_GET(chIndex);
		//-----------------------------------------
		// 2) excute the special movement according to the status of the level's change 
		if(m_atMonitorIoLimit[chIndex].chLevelLst != chCurLevel)
		{ 
		    // stop immediately
	        if(0 == m_atMonitorIoLimit[chIndex].nStepsSlow) 
	        {
	            m_atMotorControl[chIndex].nStepsAcc   = 0;
	    		m_atMotorControl[chIndex].nStepsEqu   = 0;
	    		m_atMotorControl[chIndex].nStepsDec   = 0;
	            m_atMotorControl[chIndex].nStepsTotal = 0;
			}
			// stop smoothly
			else                                 
			{
			    if(m_atMonitorIoLimit[chIndex].nStepsSlow >= m_atMotorControl[chIndex].nStepsDec)
				{
	                m_atMotorControl[chIndex].nStepsAcc   = 0;
				    m_atMotorControl[chIndex].nStepsEqu   = m_atMonitorIoLimit[chIndex].nStepsSlow - m_atMotorControl[chIndex].nStepsDec;
					// m_atMotorControl[chIndex].nStepsDec   = m_atMotorControl[chIndex].nStepsDec;
	                m_atMotorControl[chIndex].nStepsTotal = m_atMonitorIoLimit[chIndex].nStepsSlow;
				}
				else
				{
	                m_atMotorControl[chIndex].nStepsAcc   = 0;
				    m_atMotorControl[chIndex].nStepsEqu   = 0;
					m_atMotorControl[chIndex].nStepsDec   = m_atMonitorIoLimit[chIndex].nStepsSlow;
	                m_atMotorControl[chIndex].nStepsTotal = m_atMonitorIoLimit[chIndex].nStepsSlow; // m_atMotorControl[chIndex].nStepsDec;
				}
			}
			//-----------------------------------------
			// 3) attention: only for one time !!!
		    m_atMonitorIoLimit[chIndex].bAble = e_False;

		    m_io_level_changed[chIndex] = 0xff;     /* 记录光耦电平翻转的状态 */
		} // end of if
		
		//-----------------------------------------
		// 4) update the current level of the IO 
	    m_atMonitorIoLimit[chIndex].chLevelLst = chCurLevel;

	} // end of if

	// 2. for other's IO input

	return;
}	

uint8_t  MTx_GetIoLevel(uint8_t chIndex)
{
    uint8_t  XRAM_ chLevel;

    // check
    if(chIndex >= MTx_NUM)
    {
		return e_Feedback_Error;
	}

	chLevel = MTx_IN_LIMIT_GET(chIndex);

	//
	return chLevel;
}


//-----------------------------------------------------------------------------------------
// function declaration, using the timer's interrupt

// 
void   MTx_PWM_ISR(uint8_t chIndex)  // _USE  MTx_TIMER_INTERRUPT_INDEX
{
    // static variables
    __IO uint32_t IRAM_ s_nTheSameStepsCount = 0;
	__IO uint32_t IRAM_ s_nTimerLoadedIndex  = 0;

    // check
    if(chIndex >= MTx_NUM)
    {
		return;   // error
	}
	
	//------------------------------------------------------------
	// 1. for testing, output the curve of the movement
#if MTx_WAVE_OUTPUT(chIndex)
	// __IO char XRAM_ str[50];
#endif
    //------------------------------------------------------------
	// 2. shut down the timer
	MTx_TIMER_INTERRUPT_OFF(chIndex);   // no nestification is allowed
    MTx_TIMER_INTERRUPT_FLAG_CLEAR(chIndex); // clean the interrupt event

    //------------------------------------------------------------
    //************************************************************
	// 3. PWM-processing

	MTx_TIMER_LOAD(chIndex, m_atMotorControl[chIndex].nTimeLoad);

	// 1) phase changing
	switch(m_atMotorControl[chIndex].ePhase)
	{
	    //--
        case Motor_Phase_IDLE:
		{
            if(m_atMotorControl[chIndex].nStepsTotal > 0) // check 
            {
                if(Motor_Direction_Negative == m_atMotorControl[chIndex].eDirection)
                {
                    MTx_OUT_DIR_NEGATIVE(chIndex);
				}
				else
				{
                    MTx_OUT_DIR_POSITIVE(chIndex);
				}
				m_atMotorControl[chIndex].ePhase = Motor_Phase_ACC; // Motor_Phase_LOAD -> Motor_Phase_ACC
				s_nTheSameStepsCount             = 0;
				// don't break out "switch" and continue
			}
			else
			{
                break;  // break out "switch"
			}
		}
#if 0		
		//--
		case Motor_Phase_LOAD:
		{
            m_atMotorControl[chIndex].nCurFreq  = m_atMotorControl[chIndex].nFreqMin;
			s_nTimerLoadedIndex       = m_atMotorControl[chIndex].nCurFreq >> MTx_FREQ_OFFSET_BITS(chIndex);
			m_atMotorControl[chIndex].nTimeLoad = m_acTimerLoad[s_nTimerLoadedIndex];
			m_atMotorControl[chIndex].ePhase    = Motor_Phase_ACC;	 		  
            s_nTheSameStepsCount      = 0;
			// don't break out "switch" and continue
		}
#endif		
		//--
		case Motor_Phase_ACC:
		{
            if(m_atMotorControl[chIndex].nStepsAcc > 0)
            {
                // a new pulse of PWM 
                MTx_OUT_PULSE_HIGH(chIndex);
				// the end of a frequence-stair 
				if(s_nTheSameStepsCount >= m_atMotorControl[chIndex].nFreqSam)
				{
				    // reset
                    s_nTheSameStepsCount      = 0;
					// increase 
                    m_atMotorControl[chIndex].nCurFreq += m_atMotorControl[chIndex].nFreqInc;
					if(m_atMotorControl[chIndex].nCurFreq > m_atMotorControl[chIndex].nFreqMax) // protect
					{
                        m_atMotorControl[chIndex].nCurFreq = m_atMotorControl[chIndex].nFreqMax;
					}
					else
					{
                        // keep
					}
                    // get the timer reloaded value
    			    s_nTimerLoadedIndex       = m_atMotorControl[chIndex].nCurFreq >> MTx_FREQ_OFFSET_BITS(chIndex);  
   	                m_atMotorControl[chIndex].nTimeLoad = m_acTimerLoad[s_nTimerLoadedIndex]; // mapping   
				}
                // set the timer's reloaded-value
			    // MTx_TIMER_LOAD(chIndex, m_atMotorControl[chIndex].nTimeLoad);
	    	    // counting
			    m_atMotorControl[chIndex].nStepsAcc    -= 1;
			    m_atMotorControl[chIndex].nStepsTotal  -= 1;
			    // add 1
			    s_nTheSameStepsCount++;

			    break;  // break out for next pulse		
			}
			else
			{
			    m_atMotorControl[chIndex].nCurFreq += m_atMotorControl[chIndex].nFreqInc;
				if(m_atMotorControl[chIndex].nCurFreq > m_atMotorControl[chIndex].nFreqMax) // protect
				{
                    m_atMotorControl[chIndex].nCurFreq = m_atMotorControl[chIndex].nFreqMax;
				}
				else
				{
                    // keep
				}
				s_nTimerLoadedIndex                 = m_atMotorControl[chIndex].nCurFreq >> MTx_FREQ_OFFSET_BITS(chIndex);  
   	            m_atMotorControl[chIndex].nTimeLoad = m_acTimerLoad[s_nTimerLoadedIndex]; // mapping 				// 
				// 
				m_atMotorControl[chIndex].ePhase    = Motor_Phase_EQU;  
			    s_nTheSameStepsCount                = 0;			
			    // don't break out "switch" and continue
			}
		}
		//--
		case Motor_Phase_EQU:
		{
            if(m_atMotorControl[chIndex].nStepsEqu > 0)
    		{
    		    // a new pulse of PWM 
                MTx_OUT_PULSE_HIGH(chIndex);    		    	
    			// keep the timer's reloaded-value
			    // MTx_TIMER_LOAD(m_atMotorControl[chIndex].nTimeLoad);   
    			// counting
    			m_atMotorControl[chIndex].nStepsEqu    -= 1;
    			m_atMotorControl[chIndex].nStepsTotal  -= 1;
				
    			break;  // break out for next pulse	
    		}
			else
			{
                m_atMotorControl[chIndex].ePhase        = Motor_Phase_DEC;  
			    s_nTheSameStepsCount          = 0;
			    // don't break out "switch" and continue
			}
		}
		//--
		case Motor_Phase_DEC:
		{
            if(m_atMotorControl[chIndex].nStepsDec > 0)
     		{   
     		    // a new pulse of PWM 
                MTx_OUT_PULSE_HIGH(chIndex);  		    
     			if(s_nTheSameStepsCount >= m_atMotorControl[chIndex].nFreqSam)
     			{
     			    // reset
     			    s_nTheSameStepsCount      = 0;
					// reduce 
     				if(m_atMotorControl[chIndex].nCurFreq >= (m_atMotorControl[chIndex].nFreqInc + m_atMotorControl[chIndex].nFreqMin) ) // protect  
     				{
                        m_atMotorControl[chIndex].nCurFreq -= m_atMotorControl[chIndex].nFreqInc;
     				} 
					else
					{
                        // keep
					}
         			// get the timer reloaded value
         			s_nTimerLoadedIndex       = m_atMotorControl[chIndex].nCurFreq >> MTx_FREQ_OFFSET_BITS(chIndex);     
        	        m_atMotorControl[chIndex].nTimeLoad = m_acTimerLoad[s_nTimerLoadedIndex]; // mapping
     			}     			
     			// set the timer's reloaded-value
     			// MTx_TIMER_LOAD(chIndex, m_atMotorControl[chIndex].nTimeLoad);     
     			// counting
     			m_atMotorControl[chIndex].nStepsDec    -= 1;
     			m_atMotorControl[chIndex].nStepsTotal  -= 1;     				
     			// add 1
     			s_nTheSameStepsCount++;
     			
     			break;	 // break out for next pulse	
     		}
			else 
		    {	
			    m_atMotorControl[chIndex].ePhase        = Motor_Phase_FIN;
			    s_nTheSameStepsCount          = 0;
                // don't break out "switch" and continue
		    }
		}
		//--
		case Motor_Phase_FIN:
		{
             MTx_DriverEnable(chIndex, e_False);  // stop immediately
             m_atMotorControl[chIndex].ePhase           = Motor_Phase_IDLE;
			 break;
		}
		//--
		default:
		{
             MTx_DriverEnable(chIndex, e_False);  // stop immediately
             m_atMotorControl[chIndex].ePhase           = Motor_Phase_IDLE;
			 break;
		}
	} // end of "switch"

	// 2) compute the absolute location
    if( Motor_Phase_IDLE != m_atMotorControl[chIndex].ePhase)
    {
        //       --- 1 ---    
        if(MTx_LINE_MOV(chIndex)) 
		{
	        if(Motor_Direction_Negative == m_atMotorControl[chIndex].eDirection)
	        {
	            if(m_atMotorStatus[chIndex].nStepsCur > 0)
	            {
	   		        m_atMotorStatus[chIndex].nStepsCur -= 1;
	            } 
			}
	        else
	        {
	            if(m_atMotorStatus[chIndex].nStepsCur < MTx_VALUE_DISTANCE_MAX(chIndex))
	    		{ 
	    		    m_atMotorStatus[chIndex].nStepsCur += 1;
	    		}
			}
		}	
        //       --- 2 ---
        if(MTx_CIRCLE_MOV(chIndex))
		{
	        if(Motor_Direction_Negative == m_atMotorControl[chIndex].eDirection)
	        {
	            if(m_atMotorStatus[chIndex].nStepsCur > 0)
	            {
	   		        m_atMotorStatus[chIndex].nStepsCur -= 1;
	            }
				else
				{
	                m_atMotorStatus[chIndex].nStepsCur  = (MTx_VALUE_DISTANCE_MAX(chIndex) - 1);
				}
			}
	        else
	        {
	            if(m_atMotorStatus[chIndex].nStepsCur < (MTx_VALUE_DISTANCE_MAX(chIndex) - 1) )
	    		{ 
	    		    m_atMotorStatus[chIndex].nStepsCur += 1;
	    		}
				else
				{
	                m_atMotorStatus[chIndex].nStepsCur  = 0;
				}
			} 
			
		} // end of if	
		

    } // end of if

    // 3) monitor the change of the special IO's level
#if 1
    MTx_IoMinitor(chIndex);
#endif

    // 4) ending current pulse, pulls down 
    MTx_OUT_PULSE_LOW(chIndex); 


	//************************************************************
    //------------------------------------------------------------
	// 4. for debug, outputs the curve
#if 0 // MTx_WAVE_OUTPUT(chIndex)
    MTx_TIMER_COUNT_OFF(chIndex);     // disable counting of the timer
/*                              // real-time output the frequence of the motors
    printf("Phase:%0.2u - V:%0.6u, L:%0.8X \r\n", 
                 (int)m_atMotorControl[chIndex].ePhase, 
                 (int)m_atMotorControl[chIndex].nCurFreq, 
                 (int)m_atMotorControl[chIndex].nTimeLoad ); 
*/    
    printf("Phase:%0.2u - V:%0.6u, L:%0.8X \r\n", 
                 (int)m_atMotorControl[chIndex].ePhase, 
                 (int)m_atMotorControl[chIndex].nCurFreq, 
                 (int)m_atMotorControl[chIndex].nTimeLoad );
	if(Motor_Phase_IDLE != m_atMotorControl[chIndex].ePhase)
	{
        MTx_TIMER_COUNT_ON(chIndex);  // enable counting of the timer unless the movement has finished
	}
#endif
    

    //------------------------------------------------------------
	// 5. enable the timer
	MTx_TIMER_INTERRUPT_ON(chIndex);

    return;
}



#endif






